## smart-sorter/esp32/main/Kconfig.projbuild
```kconfig
menu "Smart Sorter (P2/P8)"

    config SORTER_HW_TEST
        bool "Chế độ kiểm tra đấu dây (không chạy FSM/UART)"
        default n
        help
            Khi bật, app_main chạy tuần tự: động cơ 2 s, quét servo A rồi B,
            nháy từng LED, kêu còi, rồi in trạng thái cảm biến và E-stop mỗi 200 ms (vô hạn).
            Không chạy máy trạng thái, không mở UART2 giao thức.

    choice SORTER_SENSOR
        prompt "Cảm biến phát hiện kiện hàng (E-03)"
        default SORTER_SENSOR_TCRT5000

        config SORTER_SENSOR_TCRT5000
            bool "TCRT5000 — chân DO GPIO34, ngắt + chống dội 20 ms"
        config SORTER_SENSOR_HCSR04
            bool "HC-SR04 — TRIG GPIO13 / ECHO GPIO35, đo mỗi 30 ms"
    endchoice

    config SORTER_TCRT_ACTIVE_LOW
        bool "TCRT5000: DO xuống LOW khi có vật (module so sánh LM393 thông dụng)"
        depends on SORTER_SENSOR_TCRT5000
        default y

    config SORTER_OTA_DEVICE_ID
        string "Tên thiết bị trong báo cáo OTA (O-14)"
        default "sorter-esp32-01"

    config SORTER_OTA_WIFI_TIMEOUT_S
        int "Thời gian chờ Wi-Fi lấy IP khi OTA (giây)"
        default 20
        range 5 120

    config SORTER_OTA_SELFTEST_TIMEOUT_S
        int "Thời gian self-test chờ PING từ Pi sau OTA (giây, O-13)"
        default 30
        range 5 300

    config SORTER_OTA_SELFTEST_FAIL_DEMO
        bool "DEMO: cố ý không trả lời PING để self-test thất bại (thử rollback)"
        default n
        help
            Chỉ dùng để build bản demo quay lui (OTA_TEST.md). Firmware này không gửi PONG,
            nên self-test O-13 thất bại và bootloader quay về bản cũ. KHÔNG phát hành bản này.

endmenu
```
